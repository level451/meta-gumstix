## conf/layer.conf
```bitbake
# We have a conf directory, append to BBPATH
BBPATH .= ":${LAYERDIR}"

# We have a recipes-* directory, add to BBFILES
BBFILES += "${LAYERDIR}/recipes-*/*/*.bb \
            ${LAYERDIR}/recipes-*/*/*.bbappend"

BBFILE_COLLECTIONS += "meta-gumstix-level451"
BBFILE_PATTERN_meta-gumstix-level451 = "^${LAYERDIR}/"
BBFILE_PRIORITY_meta-gumstix-level451 = "100"
```
